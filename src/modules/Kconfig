## src/modules/Kconfig
```kconfig
#
# Copyright (c) 2022 Nordic Semiconductor ASA
#
# SPDX-License-Identifier: LicenseRef-Nordic-5-Clause
#

menuconfig APP_WORKLOAD_SIM
    bool "Simulated workload"

if APP_WORKLOAD_SIM

config APP_WORKLOAD_TIME_PER_SAMPLE
	int "CPU load time per sample [us]"
	default 10
	help
	  Simulated CPU busy time when processing sensor aggregator event.
	  Sensor aggregator event comes with number of aggregated events.
	  Simulated busy time is multiplied by this value.

endif # APP_WORKLOAD_SIM

menuconfig APP_SENSOR_STUB_GEN
	bool "Implement the generator functions for sensor stub"
	default y if SENSOR_STUB

if APP_SENSOR_STUB_GEN

module = APP_SENSOR_STUB_GEN
module-str = sensor stub controller
source "subsys/logging/Kconfig.template.log_config"

endif # APP_SENSOR_STUB_GEN
```
